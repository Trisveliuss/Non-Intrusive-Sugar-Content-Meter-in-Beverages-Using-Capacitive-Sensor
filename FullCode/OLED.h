#include <Wire.h>
#include <Adafruit_GFX.h>
#include <Adafruit_SSD1306.h>
#include <Fonts/FreeSans9pt7b.h>
#include <Fonts/FreeSansBold9pt7b.h>
#include <Fonts/FreeSansBold18pt7b.h>
#define SCREEN_WIDTH 128
#define SCREEN_HEIGHT 64
#define OLED_RESET -1
Adafruit_SSD1306 display(SCREEN_WIDTH, SCREEN_HEIGHT, &Wire, OLED_RESET);

//----- ADS1115 -----//
#include <Adafruit_ADS1X15.h>
Adafruit_ADS1115 ads;

namespace OLED {

// 'scrollbar_background', 8x64px
const unsigned char ScrollBar[] PROGMEM = {
  0x00, 0x02, 0x00, 0x02, 0x00, 0x02, 0x00, 0x02, 0x00, 0x02, 0x00, 0x02, 0x00, 0x02, 0x00, 0x02,
  0x00, 0x02, 0x00, 0x02, 0x00, 0x02, 0x00, 0x02, 0x00, 0x02, 0x00, 0x02, 0x00, 0x02, 0x00, 0x02,
  0x00, 0x02, 0x00, 0x02, 0x00, 0x02, 0x00, 0x02, 0x00, 0x02, 0x00, 0x02, 0x00, 0x02, 0x00, 0x02,
  0x00, 0x02, 0x00, 0x02, 0x00, 0x02, 0x00, 0x02, 0x00, 0x02, 0x00, 0x02, 0x00, 0x02, 0x00, 0x00
};

// 'item_sel_outline', 128x21px
const unsigned char SelOutline[] PROGMEM = {
  0x1f, 0xff, 0xff, 0xff, 0xff, 0xff, 0xff, 0xff, 0xff, 0xff, 0xff, 0xff, 0xff, 0xff, 0xff, 0xc0,
  0x20, 0x00, 0x00, 0x00, 0x00, 0x00, 0x00, 0x00, 0x00, 0x00, 0x00, 0x00, 0x00, 0x00, 0x00, 0x20,
  0x40, 0x00, 0x00, 0x00, 0x00, 0x00, 0x00, 0x00, 0x00, 0x00, 0x00, 0x00, 0x00, 0x00, 0x00, 0x30,
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  0x1f, 0xff, 0xff, 0xff, 0xff, 0xff, 0xff, 0xff, 0xff, 0xff, 0xff, 0xff, 0xff, 0xff, 0xff, 0xc0
};

// 'BrixIcon', 16x16px
const unsigned char brixIcon[] PROGMEM = {
  0xe0, 0x00, 0xa0, 0x00, 0xe0, 0x00, 0x00, 0x00, 0x1f, 0x00, 0x10, 0x80, 0x10, 0x80, 0x10, 0x80,
  0x11, 0x22, 0x1f, 0x22, 0x11, 0x94, 0x10, 0x88, 0x10, 0x94, 0x10, 0xa2, 0x1f, 0x22, 0x00, 0x00
};
// 'GramIcon', 16x16px
const unsigned char gramIcon[] PROGMEM = {
  0x00, 0x00, 0x01, 0x80, 0x02, 0x40, 0x02, 0x40, 0x01, 0x80, 0x1f, 0xf8, 0x1e, 0x78, 0x1d, 0xb8,
  0x3d, 0xbc, 0x3d, 0xbc, 0x3e, 0x3c, 0x7f, 0xbe, 0x7d, 0xbe, 0x7e, 0x7e, 0x7f, 0xfe, 0x00, 0x00
};
// 'ADCIcon', 16x16px
const unsigned char ADCIcon[] PROGMEM = {
  0x00, 0x00, 0x00, 0x00, 0x18, 0x00, 0x24, 0x00, 0x42, 0x00, 0x42, 0x00, 0x81, 0x00, 0x81, 0x00,
  0xd5, 0xab, 0x00, 0x81, 0x00, 0x81, 0x00, 0x42, 0x00, 0x42, 0x00, 0x24, 0x00, 0x18, 0x00, 0x00
};
// 'VoltIcon', 16x16px
const unsigned char voltIcon[] PROGMEM = {
  0x00, 0x00, 0x00, 0xe0, 0x70, 0xce, 0x71, 0x8e, 0x31, 0xcc, 0x30, 0x4c, 0x18, 0x98, 0x19, 0x18,
  0x0d, 0x30, 0x0c, 0x30, 0x06, 0x60, 0x06, 0x60, 0x03, 0xc0, 0x03, 0xc0, 0x01, 0x80, 0x00, 0x00
};
// 'InfoIcon', 16x16px
const unsigned char infoIcon[] PROGMEM = {
  0x07, 0xe0, 0x18, 0x18, 0x20, 0x04, 0x41, 0x82, 0x41, 0x82, 0x80, 0x01, 0x80, 0x01, 0x81, 0x81,
  0x81, 0x81, 0x81, 0x81, 0x81, 0x81, 0x41, 0x82, 0x41, 0x82, 0x20, 0x04, 0x18, 0x18, 0x07, 0xe0
};

// Array of all bitmaps for convenience. (Total bytes used to store images in PROGMEM = 240)
const int icons_LEN = 5;
const unsigned char* icons[5] = {
  brixIcon,
  gramIcon,
  ADCIcon,
  voltIcon,
  infoIcon
};

const int NUM_ITEMS = 5;         // number of items in the list and also the number of screenshots and screenshots with QR codes (other screens)
const int MAX_ITEM_LENGTH = 20;  // maximum characters for the item name

char menu_items[NUM_ITEMS][MAX_ITEM_LENGTH] = {  // array with item names
  { "Brix" },
  { "Gram" },
  { "ADC" },
  { "Volt" },
  { "Info" }
};

int item_selected = 0;  // which item in the menu is selected
int item_sel_previous;  // previous item - used in the menu screen to draw the item before the selected one
int item_sel_next;      // next item - used in the menu screen to draw next item after the selected one

float start;

void setup() {
  display.begin(SSD1306_SWITCHCAPVCC, 0x3C);  // Alamat default I2C 0x3C
  display.clearDisplay();
  if (!ads.begin()) {
    Serial.println("Failed to initialize ADS.");
    while (1)
      ;
  }
  ads.setGain(GAIN_TWO);
  start = ads.readADC_SingleEnded(0) * 0.0625;
}

void menu() {
  display.clearDisplay();

  item_sel_previous = item_selected - 1;
  if (item_sel_previous < 0) { item_sel_previous = NUM_ITEMS - 1; }  // previous item would be below first = make it the last
  item_sel_next = item_selected + 1;
  if (item_sel_next >= NUM_ITEMS) { item_sel_next = 0; }  // next item would be after last = make it the first

  display.drawBitmap(120, 0, ScrollBar, 8, 64, WHITE);
  display.drawBitmap(0, 22, SelOutline, 128, 21, WHITE);
  display.fillRect(125, 64 / NUM_ITEMS * item_selected, 3, 64 / NUM_ITEMS, WHITE);

  // previous item
  display.setFont(&FreeSans9pt7b);
  display.setTextColor(WHITE);
  display.setCursor(30, 15);
  display.print(menu_items[item_sel_previous]);
  display.drawBitmap(4, 2, icons[item_sel_previous], 16, 16, WHITE);

  // selected item
  display.setFont(&FreeSansBold9pt7b);
  display.setTextColor(WHITE);
  display.setCursor(30, 37);
  display.print(menu_items[item_selected]);
  display.drawBitmap(4, 24, icons[item_selected], 16, 16, WHITE);

  // next item
  display.setFont(&FreeSans9pt7b);
  display.setTextColor(WHITE);
  display.setCursor(30, 59);
  display.print(menu_items[item_sel_next]);
  display.drawBitmap(4, 46, icons[item_sel_next], 16, 16, WHITE);

  display.display();
}

void next() {
  item_selected++;
  if (item_selected >= NUM_ITEMS) { item_selected = 0; }
}

void previous() {
  item_selected--;
  if (item_selected < 0) { item_selected = NUM_ITEMS - 1; }
}

void brix() {
  int16_t adc = ads.readADC_SingleEnded(0);
  float millivolt = adc * 0.0625;
  float delta = millivolt - start - 100;
  float brix = 240.35 - 0.3 * delta;
  display.clearDisplay();
  display.setFont(&FreeSansBold18pt7b);
  display.setTextColor(WHITE);
  display.setCursor(5, 50);
  display.print(brix, 2);
  display.setFont(&FreeSansBold9pt7b);
  display.setTextColor(WHITE);
  display.setCursor(0, 13);
  display.print("Brix");
  display.display();
  delay(200);
}

void gram() {
  int16_t adc = ads.readADC_SingleEnded(0);
  float millivolt = adc * 0.0625;
  float delta = millivolt - start - 100;
  float brix = 240.35 - 0.3 * delta;
  display.clearDisplay();
  display.setFont(&FreeSansBold18pt7b);
  display.setTextColor(WHITE);
  display.setCursor(5, 50);
  display.print(brix, 2);
  display.setFont(&FreeSansBold9pt7b);
  display.setTextColor(WHITE);
  display.setCursor(0, 13);
  display.print("g/100 mL");
  display.display();
  delay(200);
}

void adc() {
  int16_t adc = ads.readADC_SingleEnded(0);
  display.clearDisplay();
  display.setFont(&FreeSansBold18pt7b);
  display.setTextColor(WHITE);
  display.setCursor(15, 50);
  display.print(adc);
  display.setFont(&FreeSansBold9pt7b);
  display.setTextColor(WHITE);
  display.setCursor(0, 13);
  display.print("ADC");
  display.display();
  delay(200);
}

void volt() {
  int16_t adc = ads.readADC_SingleEnded(0);
  float millivolt = adc * 0.0625;
  display.clearDisplay();
  display.setFont(&FreeSansBold18pt7b);
  display.setTextColor(WHITE);
  display.setCursor(5, 50);
  display.print(millivolt - start, 3);
  display.setFont(&FreeSansBold9pt7b);
  display.setTextColor(WHITE);
  display.setCursor(0, 13);
  display.print("mV");
  display.display();
  delay(200);
}

void info() {
  display.clearDisplay();
  display.setFont();
  display.setTextSize(1);
  display.setTextColor(WHITE);
  display.setCursor(7, 0);
  display.println("Non-Intrusive Sugar");
  display.setCursor(10, 15);
  display.println("Meter In Beverages");
  display.setCursor(4, 30);
  display.println("By: Tristan Novelius");
  display.setCursor(46, 40);
  display.println("Wibowo");
  display.setCursor(52, 55);
  display.println("2025");
  display.display();
}

}